## IntercomListenerEsp32/src/Kconfig.projbuild
```kconfig
menu "IntercomListener General"
    
    config INTERCOM_DEEP_SLEEP_ENABLED
        bool "Deep sleep enabled"
        default true

    config INTERCOM_RING_GPIO_PIN
        int "Ring sensor pin"
        default 33

    config INTERCOM_RING_DETECTION_COOLDOWN
        int "Ring detection cooldown in milliseconds"
        default 1000

    config INTERCOM_RING_NOTIFICATION_COOLDOWN
        int "Ring notification cooldown in milliseconds"
        default 5000

    config INTERCOM_WAKE_LEVEL
        int "Ring sensor pin level that wakes the MCU"
        default 0

    choice INTERCOM_LOG_LEVEL
        prompt "Log level for the application"
        default INTERCOM_LOG_LEVEL_INFO
        help
            Select log level for the application code. Other Framework components will follow CONFIG_LOG_DEFAULT_LEVEL setting.
        config INTERCOM_LOG_LEVEL_ERROR
            bool "Error"
        config INTERCOM_LOG_LEVEL_WARNING
            bool "Warning"
        config INTERCOM_LOG_LEVEL_INFO
            bool "Info"
        config INTERCOM_LOG_LEVEL_DEBUG
            bool "Debug"
        config INTERCOM_LOG_LEVEL_VERBOSE
            bool "Verbose"
    endchoice

    config INTERCOM_DEEP_SLEEP_DELAY
        int "MCU will go to sleep if inactive during this time" 
        default 30

    config INTERCOM_DEEP_SLEEP_DURATION_ENABLED
        bool "Deep sleep auto wake up"
        default false

    config INTERCOM_DEEP_SLEEP_DURATION
        int "Wake up timer period in seconds" 
        default 120

    config INTERCOM_LED_BLUE_GPIO_PIN
        int "Blue LED GPIO Pin. -1 to disable."
        default 4

    config INTERCOM_LED_GREEN_GPIO_PIN
        int "Green LED GPIO Pin. -1 to disable."
        default 2
    
    config INTERCOM_LED_RED_GPIO_PIN
        int "Red LED GPIO Pin. -1 to disable."
        default 0

endmenu

menu "IntercomListener Telegram Notifications"
    config INTERCOM_TELEGRAM_ENABLED
        bool "Are Telegram notifications enabled"
        default true

    config INTERCOM_TELEGRAM_API_KEY
        string "Telegram Bot API key"
    
    config INTERCOM_TELEGRAM_CHAT_ID
        string "Telegram chat id"
endmenu

menu "IntercomListener WiFi"
    config INTERCOM_WIFI_SSID
        string "WiFi SSID"

    config INTERCOM_WIFI_PASSWORD
        string "WiFi Password"

    choice INTERCOM_WIFI_SAE_MODE
        prompt "WPA3 SAE mode selection"
        default INTERCOM_WIFI_WPA3_SAE_PWE_BOTH
        help
            Select mode for SAE as Hunt and Peck, H2E or both.
        config INTERCOM_WIFI_WPA3_SAE_PWE_HUNT_AND_PECK
            bool "HUNT AND PECK"
        config INTERCOM_WIFI_WPA3_SAE_PWE_HASH_TO_ELEMENT
            bool "H2E"
        config INTERCOM_WIFI_WPA3_SAE_PWE_BOTH
            bool "BOTH"
    endchoice

    config INTERCOM_WIFI_PW_ID
        string "PASSWORD IDENTIFIER"
        depends on INTERCOM_WIFI_WPA3_SAE_PWE_HASH_TO_ELEMENT|| INTERCOM_WIFI_WPA3_SAE_PWE_BOTH
        default ""
        help
            password identifier for SAE H2E

    config INTERCOM_WIFI_MAXIMUM_RETRY
        int "Maximum retry"
        default 5
        help
            Set the Maximum retry to avoid station reconnecting to the AP unlimited when the AP is really inexistent.

    choice INTERCOM_WIFI_SCAN_AUTH_MODE_THRESHOLD
        prompt "WiFi Scan auth mode threshold"
        default INTERCOM_WIFI_AUTH_WPA2_PSK
        help
            The weakest authmode to accept in the scan mode.
            This value defaults to INTERCOM_WIFI_AUTH_WPA2_PSK incase password is present and INTERCOM_WIFI_AUTH_OPEN is used.
            Please select INTERCOM_WIFI_AUTH_WEP/INTERCOM_WIFI_AUTH_WPA_PSK incase AP is operating in WEP/WPA mode.

        config INTERCOM_WIFI_AUTH_OPEN
            bool "OPEN"
        config INTERCOM_WIFI_AUTH_WEP
            bool "WEP"
        config INTERCOM_WIFI_AUTH_WPA_PSK
            bool "WPA PSK"
        config INTERCOM_WIFI_AUTH_WPA2_PSK
            bool "WPA2 PSK"
        config INTERCOM_WIFI_AUTH_WPA_WPA2_PSK
            bool "WPA/WPA2 PSK"
        config INTERCOM_WIFI_AUTH_WPA3_PSK
            bool "WPA3 PSK"
        config INTERCOM_WIFI_AUTH_WPA2_WPA3_PSK
            bool "WPA2/WPA3 PSK"
        config INTERCOM_WIFI_AUTH_WAPI_PSK
            bool "WAPI PSK"
    endchoice

endmenu
```
